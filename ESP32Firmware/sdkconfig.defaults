## ESP32Firmware/sdkconfig.defaults
```kconfig
# GasTag Bridge ESP-IDF Configuration

# Enable Bluetooth
CONFIG_BT_ENABLED=y
CONFIG_BT_BLUEDROID_ENABLED=y
CONFIG_BT_BLE_ENABLED=y

# Disable Classic BT to save memory
CONFIG_BT_CLASSIC_ENABLED=n
CONFIG_BT_BLE_42_FEATURES_SUPPORTED=y

# USB Host - Enable OTG for USB Host mode
CONFIG_USB_OTG_SUPPORTED=y
CONFIG_USB_HOST_CONTROL_TRANSFER_MAX_SIZE=1024
CONFIG_USB_HOST_HW_BUFFER_BIAS_BALANCED=y

# Console - Use UART only, disable USB Serial/JTAG to free GPIO 19/20 for USB Host
CONFIG_ESP_CONSOLE_UART_DEFAULT=y
CONFIG_ESP_CONSOLE_SECONDARY_NONE=y

# Explicitly disable USB Serial/JTAG to prevent conflict with USB Host on GPIO 19/20
CONFIG_USJ_ENABLE_USB_SERIAL_JTAG=n
CONFIG_ESP_CONSOLE_USB_SERIAL_JTAG=n

# Logging - Enable verbose USB debugging
CONFIG_LOG_DEFAULT_LEVEL_INFO=y
CONFIG_LOG_MAXIMUM_LEVEL_VERBOSE=y
CONFIG_USB_HOST_ENABLE_DEBUG_LOG=y
```
